## Documentation/devicetree/bindings/arm/adi-dma2.txt
```
* ADI DMA2

Required properties:
- compatible : Should be "adi,dma2"
- reg : Should contain registers location and length
- interrupts : Should contain the interrupt numbers of DMA channels.

Optional properties:
- spu_securep_id: the secure config entry of this DMA channel in SPU.

Supported chips:
sc58x

Examples:

dma0: dma@0x31022000 {
	compatible = "adi,dma2";
	reg = <0x31022000 0x7F>;
	interrupts = <84>;
	spu_securep_id = <66>;
};
```

## Documentation/devicetree/bindings/crypto/adi-hmac-crc.txt
```
ADI Cryptographic Accelerator included in sc58x chips.

Required properties:
- compatible : Should be "adi,hmac-crc"
- reg : Should contain CRC registers location and length
- interrupts : Should contain CRC interrupt number
- dma_channel : source memory dma channel used by the CRC
- crypto_crc_poly : initial poly data for crc calculation

Example:

crc0: crc@0x31001200 {
	compatible = "adi,hmac-crc";
	reg = <0x31001200 0xFF>;
	interrupts = <0 176 0>;
	dma_channel = <8>;
	crypto_crc_poly = <0x5c5c5c5c>;
};
```

## Documentation/devicetree/bindings/gpio/gpio-button-led.txt
```
* BUTTON INTERRUPT TRIGGER LED DRIVER

Required properties:
- compatible : Should be "adi,button-led"
- button_gpio : Should contain the gpio number of a specified button.
- led_gpio : Should contain the gpio number of a specified led.


Supported chips:
sc58x

Examples:

button0: button@0 {
	compatible = "adi,button-led";
	button_gpio = <80>;
	led_gpio = <49>;
};
```

## Documentation/devicetree/bindings/input/bfin_rotary.txt
```
ADI Rotary

Required properties:
- compatible	: "adi,rotary" for rotary device on sc58x SoC family.
- reg		: address range of rotary registers
- interrupts	: rotary event
- rotary_up_key	: set rotary UP KEY_### or BTN_### in case you prefer
		  rotary to send EV_KEY otherwise set 0
- rotary_down_key : set rotary DOWN KEY_### or BTN_### in case you prefer
		    rotary to send EV_KEY otherwise set 0
- rotary_button_key : set rotary BUTTON KEY_### or BTN_###
- rotary_rel_code : set rotary Relative Axis REL_### in case you prefer
		    rotary to send EV_REL otherwise set 0
- debounce	: select the noice filtering characteristics of inputs
- debounce_en	: enable debounce
- cnt_mode	: counter operation mode 0..5
- boundary_mode	: boundary register mode 0..3
- invert_czm	: invert CZM pin polarity
- invert_cud	: invert CUD pin polarity
- invert_cdg	: invert CDG pin polarity

Example:

rotary@0x3100B000 {
	#address-cells = <1>;
	#size-cells = <0>;
	compatible = "adi,rotary";
	reg = <0x3100B000 0xFF>;
	interrupts = <0 126 0>;
	rotary_up_key = <103>;		/* KEY_UP */
	rotary_down_key = <108>;	/* KEY_DOWN */
	rotary_rel_code = <0x08>;	/* REL_WHEEL */
	rotary_button_key = <28>;	/* KEY_ENTER */
	debounce = /bits/ 16 <10>;	/* 0..17 */
	debounce_en = /bits/ 16 <1>;
	cnt_mode = /bits/ 16 <0>;	/* CNTMODE_QUADENC */
	boundary_mode = /bits/ 16 <0>;	/* BNDMODE_COMP */
	invert_czm = /bits/ 16 <0>;
	invert_cud = /bits/ 16 <0>;
	invert_cdg = /bits/ 16 <0>;
};
```

## Documentation/devicetree/bindings/pinctrl/pinctrl-adi2.txt
```
ADI pinmux controller

Required properties:
- compatible	: "adi,adi2-pinctrl"
- reg		: Address range of the pinctrl registers
- interrupt-controller  : Marks the device node as an interrupt controller

Please refer to pinctrl-bindings.txt in this directory for details of the common
pinctrl bindings used by client devices.

ADI2 pinmux nodes act as a container for subnodes.

[pin state node]
Each of these subnodes represents some desired configuration for a group of pins.

Required subnode-properties:
- adi,group : An array of strings. Each string contains the name of a group.
- adi,function: A string containing the name of the function to mux to the
  group.

  Valid values for group and function names can be found from looking at the
  group and function arrays in driver files:
  drivers/pinctrl/pinctrl-adi2-sc58x.c


ADI pint controller

A gpio interrupt multiplex device owned by a pinmux controller.

Required properties:
- compatible	: "adi,pint"
- reg		: Address range of the pint registers
- interrupts	: Interrupts used by every pint device

ADI gport controller

A gpio port device owned by a pinmux controller.

Required properties:
- compatible	: "adi,gport"
- reg		: Address range of the gpio port registers
- gpio-controller : Indicates this device is a GPIO controller
- port_width	: Pin count of this gpio port
- gpio-ranges	: refer to bindings/gpio/gpio.txt
- pint_id	: Pint device id that gpio interrupts of this gpio port maps to
- pint_assign	: A gpio port can be mapped into either low 16 bits[false] or
		  high 16 bits[true] of a pint device.
- pint_map	: Mapping code of a gpio port in a pint device

Optional subnode-properties:
- port_gpio_base: Global GPIO index of this gpio port, not set or -1 means
		  minimum available index.


For example, pinctrl might have subnodes like the following:

 pint0: pint@0x31005000 {
         compatible = "adi,pint";
         reg = <0x31005000 0xFF>;
         interrupts = <0 70 0>;
 };

 gpa: gport@0x31004000 {
         compatible = "adi,gport";
         reg = <0x31004000 0x7F>;
         port_gpio_base = <0>;
         port_width = <16>;
         gpio-ranges = <&pinctrl0 0 0 16>;
         pint_id =  /bits/ 8 <0>;
         pint_assign;
         pint_map =  /bits/ 8 <0>;
 };

 uart {
         uart0_pins_a: uart0@0 {
                 adi,group = "uart0grp";
                 adi,function = "uart0";
         };
         uart0_hwflow_pins_a: uart0@1 {
                 adi,pins = "uart0_hwflowgrp";
                 adi,function = "uart0";
         };
 };

For a specific board, if it wants to use uart0 without hardware flow control
by default, it can add the following to its board-specific .dts file.
uart0: uart@0x31003000 {
	pinctrl-names = "default", "hwflow";
	pinctrl-0 = <&uart0_pins_a>;
	pinctrl-1 = <&uart0_hwflow_pins_a>;
}
```

## Documentation/devicetree/bindings/rtc/rtc-adi2.txt
```
ADI Real Time Clock v2

Required properties:
- compatible	: "adi,rtc2" for RTC on sc58x SoC family.
- reg		: Address range of rtc registers
- interrupts	: rtc events
- calibration	: The time seconds correction at the end of every day. Range
		  1 ~ 7 means to delay 0 to 7 seconds. Range 9 ~ 15 means to
		  speed up 1 ~ 7 seconds.

Example:

rtc@0x310C8000 {
	compatible = "adi,rtc2";
	reg = <0x310C8000 0x100>;
	interrupts = <0 165 0>;
	calibration = /bits/ 8 <0>;
};
```

## Documentation/devicetree/bindings/tty/serial/adi-uart4.txt
```
* ADI Universal Asynchronous Receiver/Transmitter revision 4 (UART)

Required properties:
- compatible : Should be "arm,adi-uart4"
- reg : Address and length of the register set for the device
- interrupts : Should contain uart tx, rx, status interrupts
- dma-channel : tx, rx dma channel
- pinctrl-names, pinctrl-0: Please refer to pinctrl-bindings.txt

Optional properties:
- adi,uart-has-rtscts : Indicate the uart has rts and cts

Example:

uart0: uart@0x31003000 {
	       compatible = "arm,adi-uart4";
	       reg = <0x31003000 0x40>;
	       dma-channel = <20>, <21>;
	       pinctrl-names = "default", "hwflow";
	       pinctrl-0 = <&uart0_default>;
	       pinctrl-1 = <&uart0_hwflow>;
	       interrupt-parent = <&gic>;
	       interrupts = <0 114 0>,
			  <0 115 0>,
			  <0 116 0>;
       };
```

## Documentation/devicetree/bindings/usb/adi-usb.txt
```
ADI Universal Serial Bus(USB) GLUE

USB GLUE
~~~~~~~~
Required properties
 - compatible: Should be "ADI,musb".
 - reg: offset and length of "USB Controller Registers".
 - reg-names: "mc".
 - interrupts: USB interrupt number.
 - interrupt-names: Should be "mc" or "dma".
 - mentor,multipoint: Should be "1". It means that the musb controller supports multipoint.
 - mentor,num-eps: Should be "16".  Specifies the number of endpoints.
 - mentor,ram-bits: Should be "12". Specifies the ram address size.
 - mentor,power: Should be "500". This signifies the controller can supply up to
   500mA when operating in host mode.
 - phys: the phandle for the PHY device.

Optional properties
 - spu_securep_id: Specifies the number of usb spu.
 - mentor,dyn-fifo: Enable dynamic fifo or not.
 - mode: Specifies the type of controller. "3" represent OTG. "1" signifies HOST and "2"
   represents PERIPHERAL.

USB PHY
~~~~~~~
 - compatible: Should be "usb-nop-xceiv".
 - reg: offset and length of "PHY Controller Registers".
 - reg-names: Should be "phy".

Supported chips
~~~~~~~~~~~~~~~
sc58x

Example
~~~~~~~
usb0_phy: usb-phy@310c1390 {
	compatible = "usb-nop-xceiv";
	reg = <0x310c1390 0x10>;
	reg-names = "phy";
};

usb0: usb@310c1000 {
	compatible = "ADI,musb";
	reg = <0x310c1000 0x390>;
	reg-names = "mc";
	interrupts = <0 132 0>,
	             <0 133 0>;
	interrupt-names = "mc", "dma";
	spu_securep_id = <153>;

	mode = <3>;
	mentor,multipoint = <1>;
	mentor,num-eps = <16>;
	mentor,ram-bits = <12>;
	mentor,dma-channels = <8>;
	memtor,dyn-fifo = <0>;
	mentor,power = <500>;
	phys = <&usb0_phy>;
};
```

## arch/arm/configs/sc57x_dev_defconfig
```kconfig
CONFIG_SYSVIPC=y
# CONFIG_CROSS_MEMORY_ATTACH is not set
# CONFIG_FHANDLE is not set
CONFIG_USELIB=y
CONFIG_IRQ_DOMAIN_DEBUG=y
CONFIG_HIGH_RES_TIMERS=y
CONFIG_LOG_BUF_SHIFT=15
CONFIG_PRINTK_SAFE_LOG_BUF_SHIFT=15
CONFIG_CC_OPTIMIZE_FOR_SIZE=y
# CONFIG_KALLSYMS is not set
# CONFIG_AIO is not set
# CONFIG_MEMBARRIER is not set
CONFIG_EMBEDDED=y
# CONFIG_VM_EVENT_COUNTERS is not set
CONFIG_SLAB=y
# CONFIG_SLAB_MERGE_DEFAULT is not set
CONFIG_JUMP_LABEL=y
# CONFIG_STRICT_KERNEL_RWX is not set
# CONFIG_LBDAF is not set
# CONFIG_BLK_DEV_BSG is not set
# CONFIG_BLK_DEBUG_FS is not set
# CONFIG_MQ_IOSCHED_DEADLINE is not set
# CONFIG_MQ_IOSCHED_KYBER is not set
CONFIG_ARCH_SC57X=y
CONFIG_MACH_SC57X_GEN6=y
CONFIG_ARM_THUMBEE=y
# CONFIG_VDSO is not set
CONFIG_HAVE_ARM_ARCH_TIMER=y
CONFIG_HZ_250=y
# CONFIG_COMPACTION is not set
CONFIG_DEPRECATED_PARAM_STRUCT=y
# CONFIG_SUSPEND is not set
CONFIG_NET=y
CONFIG_PACKET=y
CONFIG_UNIX=y
CONFIG_INET=y
CONFIG_IP_PNP=y
CONFIG_IP_PNP_DHCP=y
CONFIG_IP_PNP_BOOTP=y
CONFIG_IP_PNP_RARP=y
CONFIG_SYN_COOKIES=y
# CONFIG_INET_XFRM_MODE_TRANSPORT is not set
# CONFIG_INET_XFRM_MODE_TUNNEL is not set
# CONFIG_INET_XFRM_MODE_BEET is not set
# CONFIG_INET_DIAG is not set
# CONFIG_IPV6 is not set
CONFIG_NETWORK_PHY_TIMESTAMPING=y
# CONFIG_WIRELESS is not set
# CONFIG_UEVENT_HELPER is not set
CONFIG_DEVTMPFS=y
CONFIG_DEVTMPFS_MOUNT=y
# CONFIG_FW_LOADER is not set
CONFIG_DEBUG_DRIVER=y
CONFIG_DEBUG_DEVRES=y
CONFIG_MTD=y
CONFIG_MTD_BLOCK=y
CONFIG_MTD_M25P80=y
CONFIG_MTD_SPI_NOR=y
# CONFIG_MTD_SPI_NOR_USE_4K_SECTORS is not set
CONFIG_NETDEVICES=y
CONFIG_NETCONSOLE=y
# CONFIG_NET_VENDOR_ALACRITECH is not set
# CONFIG_NET_VENDOR_AMAZON is not set
# CONFIG_NET_VENDOR_AQUANTIA is not set
# CONFIG_NET_VENDOR_ARC is not set
# CONFIG_NET_CADENCE is not set
# CONFIG_NET_VENDOR_BROADCOM is not set
# CONFIG_NET_VENDOR_CIRRUS is not set
# CONFIG_NET_VENDOR_EZCHIP is not set
# CONFIG_NET_VENDOR_FARADAY is not set
# CONFIG_NET_VENDOR_HISILICON is not set
# CONFIG_NET_VENDOR_HUAWEI is not set
# CONFIG_NET_VENDOR_INTEL is not set
# CONFIG_NET_VENDOR_MARVELL is not set
# CONFIG_NET_VENDOR_MELLANOX is not set
# CONFIG_NET_VENDOR_MICREL is not set
# CONFIG_NET_VENDOR_MICROCHIP is not set
# CONFIG_NET_VENDOR_NATSEMI is not set
# CONFIG_NET_VENDOR_NETRONOME is not set
# CONFIG_NET_VENDOR_QUALCOMM is not set
# CONFIG_NET_VENDOR_RENESAS is not set
# CONFIG_NET_VENDOR_ROCKER is not set
# CONFIG_NET_VENDOR_SAMSUNG is not set
# CONFIG_NET_VENDOR_SEEQ is not set
# CONFIG_NET_VENDOR_SOLARFLARE is not set
# CONFIG_NET_VENDOR_SMSC is not set
CONFIG_STMMAC_ETH=y
# CONFIG_NET_VENDOR_VIA is not set
# CONFIG_NET_VENDOR_WIZNET is not set
# CONFIG_NET_VENDOR_SYNOPSYS is not set
CONFIG_MICREL_PHY=y
# CONFIG_WLAN is not set
# CONFIG_INPUT_KEYBOARD is not set
# CONFIG_INPUT_MOUSE is not set
# CONFIG_SERIO is not set
CONFIG_VT_HW_CONSOLE_BINDING=y
# CONFIG_LEGACY_PTYS is not set
CONFIG_SERIAL_ADI_UART4=y
# CONFIG_HW_RANDOM is not set
# CONFIG_I2C_COMPAT is not set
CONFIG_I2C_CHARDEV=y
CONFIG_I2C_BLACKFIN_TWI=y
CONFIG_I2C_DEBUG_CORE=y
CONFIG_I2C_DEBUG_ALGO=y
CONFIG_I2C_DEBUG_BUS=y
CONFIG_SPI=y
CONFIG_SPI_ADI_V3=y
CONFIG_SPI_SPIDEV=y
CONFIG_DEBUG_PINCTRL=y
CONFIG_PINCTRL_SINGLE=y
CONFIG_GPIO_SYSFS=y
CONFIG_GPIO_GENERIC_PLATFORM=y
# CONFIG_HWMON is not set
CONFIG_WATCHDOG=y
CONFIG_ADI_WATCHDOG=y
# CONFIG_RC_CORE is not set
CONFIG_MEDIA_SUPPORT=y
CONFIG_MEDIA_CAMERA_SUPPORT=y
CONFIG_V4L_PLATFORM_DRIVERS=y
CONFIG_VIDEO_IRIS_GEN6_EPC660_CAPTURE=y
CONFIG_SOC_CAMERA=y
CONFIG_SOC_CAMERA_PLATFORM=y
CONFIG_SOC_CAMERA_EPC660=y
CONFIG_SOC_CAMERA_MT9V022=y
# CONFIG_HID is not set
# CONFIG_USB_SUPPORT is not set
CONFIG_MMC=y
CONFIG_MMC_DW=y
CONFIG_MMC_DW_ADI=y
CONFIG_DMADEVICES=y
CONFIG_STAGING=y
CONFIG_ICC_DRIVER=y
CONFIG_ICC=y
# CONFIG_IOMMU_SUPPORT is not set
CONFIG_EXT3_FS=y
# CONFIG_DNOTIFY is not set
CONFIG_TMPFS=y
CONFIG_CONFIGFS_FS=y
CONFIG_JFFS2_FS=y
# CONFIG_JFFS2_FS_WRITEBUFFER is not set
CONFIG_JFFS2_SUMMARY=y
CONFIG_NFS_FS=y
CONFIG_ROOT_NFS=y
CONFIG_NLS=y
CONFIG_NLS_DEFAULT="utf-8"
CONFIG_NLS_UTF8=y
CONFIG_DLM=y
CONFIG_DEBUG_INFO=y
CONFIG_DEBUG_FS=y
CONFIG_DEBUG_PAGEALLOC=y
# CONFIG_SCHED_DEBUG is not set
# CONFIG_FTRACE is not set
CONFIG_DEBUG_LL=y
CONFIG_EARLY_PRINTK=y
# CONFIG_CRYPTO_ECHAINIV is not set
CONFIG_CRYPTO_DEFLATE=y
CONFIG_CRYPTO_LZO=y
CONFIG_CRYPTO_ANSI_CPRNG=y
# CONFIG_CRYPTO_HW is not set
CONFIG_CRC_CCITT=y
CONFIG_XZ_DEC=y
```

## arch/arm/mach-sc57x/iris/Kconfig
```kconfig
config IRIS_CUSTOM_DRIVERS
	bool "Driver for device discovery for Iris irma-six platform"
	default n
	help
	  Custom drivers for devices produced by Iris GmbH.


menu "Iris Custom Drivers"
	depends on IRIS_CUSTOM_DRIVERS

config IRIS_IRMA_SIX_HARDWARE_DISCOVERY
	bool "Driver for hardware discovery for Iris irma-six platform"
	default n
	depends on ARCH_SC57X && OF && VIDEO_IRIS_GEN6_EPC660_CAPTURE
	help
	  A driver that can do additional device initialization and device population on irma-six devices.

config IRIS_IRMA_SIX_HADC
	bool "HADC (Housekeeping AD Converter)"
	default y
	depends on ARCH_SC57X
	help
	  Driver for Housekeeping AD Converter (HADC) on sc57x platform. A driver that can get HADC0 values via ioctls.

config IRIS_IRMA_SIX_MEM_HELPER
	bool "Memory Helper Driver"
	default y
	depends on ARCH_SC57X
	help
	  Memory Helper Driver that allows mmapping of a reserved contiguous memory region at the beginning of RAM to the userspace devices. Supports multiple contiguous regions to map the beginning of the RAM as well as the non-icc-part of the L2.

config IRIS_IRMA_SIX_TMU
	bool "TMU (Thermal monitoring unit)"
	default y
	depends on ARCH_SC57X
	help
	  Driver that provides the processor temperature on sc57x platform (via tmu).

endmenu
```

## drivers/media/platform/iris-gen6/Kconfig
```kconfig
choice
    prompt "EPC or Aptina?"
    config EPC660
          bool "EPC660"
    config APTINA_MT9V022
           bool "APTINA_MT9V022"
 endchoice

config VIDEO_IRIS_GEN6_EPC660_CAPTURE
	tristate "Iris-Gen6 Video Capture Driver for EPC660"
	depends on VIDEO_V4L2 && (BLACKFIN || ARCH_SC57X || ARCH_SC58X) && I2C
	depends on HAS_DMA
	depends on EPC660
	select VIDEOBUF2_DMA_CONTIG
	help
	  V4L2 bridge driver for Blackfin video capture device.
	  Choose PPI or EPPI as its interface.
	  To compile this driver as a module, choose M here: the
	  module will be called iris_gen6_epc660_capture.
config VIDEO_IRIS_GEN6_APTINA_MT9V022_CAPTURE
	tristate "Iris-Gen6 Video Capture Driver for APTINA_MT9V022"
	depends on VIDEO_V4L2 && (BLACKFIN || ARCH_SC57X || ARCH_SC58X) && I2C
	depends on HAS_DMA
	depends on APTINA_MT9V022
	select VIDEOBUF2_DMA_CONTIG
	help
	  V4L2 bridge driver for Blackfin video capture device.
	  Choose PPI or EPPI as its interface.
	  To compile this driver as a module, choose M here: the
	  module will be called iris_gen6_aptina_mt9v022_capture.
```
